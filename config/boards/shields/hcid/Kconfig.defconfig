## config/boards/shields/hcid/Kconfig.defconfig
```kconfig
if SHIELD_HCID_LEFT

    config ZMK_KEYBOARD_NAME
        default "HCID v0.3 left"

    config ZMK_SPLIT_BLE_ROLE_CENTRAL
        default y

endif # SHIELD_HCID_LEFT


if SHIELD_HCID_RIGHT

    config ZMK_KEYBOARD_NAME
        default "HCID v0.3 right"

    config ZMK_SPLIT_BLE_ROLE_CENTRAL
        default n

endif # SHIELD_HCID_RIGHT


if SHIELD_HCID_LEFT || SHIELD_HCID_RIGHT

    config ZMK_SPLIT
        default y

# --- FOR DISPLAY ---
   config I2C
	    default y

    config SSD1306
        default y

    config SSD1306_REVERSE_MODE
        default y

    config LVGL_HOR_RES_MAX
        default 128

    config LVGL_VER_RES_MAX
        default 32

    config LVGL_VDB_SIZE
        default 64

    config LVGL_DPI
        default 148

    config LVGL_BITS_PER_PIXEL
        default 1

    choice LVGL_COLOR_DEPTH
        default LVGL_COLOR_DEPTH_1
    endchoice 

 
endif # SHIELD_HCID_LEFT || SHIELD_HCID_RIGHT
```

## config/boards/shields/hcid/Kconfig.shield
```kconfig
# Copyright (c) 2022 The ZMK Contributors

# SPDX-License-Identifier: MIT

config SHIELD_HCID_LEFT
	def_bool $(shields_list_contains,hcid_left)

config SHIELD_HCID_RIGHT
	def_bool $(shields_list_contains,hcid_right)
```

## config/west.yml
```yaml
# manifest:
#   remotes:
#     - name: zmkfirmware
#       url-base: https://github.com/zmkfirmware
#   projects:
#     - name: zmk
#       remote: zmkfirmware
#       revision: main
#       import: app/west.yml
#   self:
#     path: config
manifest:
  remotes:
    - name: zmkfirmware
      url-base: https://github.com/artseyio
    - name: zmk-artsey
      url-base: https://github.com/artseyio
  projects:
    - name: zmk
      remote: zmkfirmware
      revision: artsey
      import: app/west.yml
  self:
    path: config
```
